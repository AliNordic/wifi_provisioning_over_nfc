## CMakeLists.txt
```
#
# Copyright (c) 2024 Nordic Semiconductor ASA
#
# SPDX-License-Identifier: LicenseRef-Nordic-5-Clause
#

cmake_minimum_required(VERSION 3.20.0)

find_package(Zephyr REQUIRED HINTS $ENV{ZEPHYR_BASE})
project(wifi_provisioning_over_nfc)

target_sources(app PRIVATE src/nfc_wifi_prov.c src/udp_client.c src/main.c )
```

## Kconfig
```
#
# Copyright (c) 2024 Nordic Semiconductor ASA
#
# SPDX-License-Identifier: LicenseRef-Nordic-5-Clause
#
menu "Wi-Fi Provisioning Over NFC"

module = WIFI_PROVISIONING_OVER_NFC
module-str = wifi provisioning over NFC

config PRESS_HOLD_RELEASE_TIME
	int "Time to press-hold&release to erase stored credentials stored in TF-M"
	default 8

config UDP_ECHO_SERVER_HOSTNAME
	string "UDP echo server to send a message to"
	default "udp-echo.nordicsemi.academy"

config UDP_ECHO_SERVER_PORT
	string "UDP echo server port number"
	default "2444"

config MESSAGE_TO_SEND
	string "Message to send to the echo server"
	help
	  This could be any string you wish to send to the echo server.
	default "Hello from nRF70 Series"

config REPLY_BUFFER_SIZE
	int "Buffer size for the received message from the server"
	default 256

endmenu

source "Kconfig.zephyr"
```

## sample.yaml
```
sample:
  name: Wi-Fi provisioning over NFC
tests:
  sample.nrf7002dk.provisioning.nfc:
    build_only: true
    integration_platforms:
      - nrf7002dk_nrf5340_cpuapp_ns
    platform_allow: nrf7002dk_nrf5340_cpuapp_ns
    tags: ci_build
  sample.nrf5340dk.provisioning.nfc:
    build_only: true
    extra_args: SHIELD=nrf7002ek
    integration_platforms:
      - nrf5340dk_nrf5340_cpuapp_ns
    platform_allow: nrf5340dk_nrf5340_cpuapp_ns
    tags: ci_build
```

## prj.conf
```kconfig
#
# Copyright (c) 2024 Nordic Semiconductor ASA
#
# SPDX-License-Identifier: LicenseRef-Nordic-5-Clause
#

# Wi-Fi
CONFIG_WIFI=y
CONFIG_WIFI_NRF700X=y
CONFIG_WPA_SUPP=y
CONFIG_WPA_SUPP_LOG_LEVEL_OFF=y

#  Wi-Fi credentials
CONFIG_WIFI_CREDENTIALS=y

# Networking Management API
CONFIG_NET_MGMT=y
CONFIG_NET_MGMT_EVENT=y
CONFIG_NET_MGMT_EVENT_INFO=y
CONFIG_NET_MGMT_EVENT_STACK_SIZE=4096
CONFIG_NET_CONNECTION_MANAGER=y

# PSA backend and other necessary Kconfigs
CONFIG_WIFI_CREDENTIALS_BACKEND_PSA=y
CONFIG_TFM_PROFILE_TYPE_MEDIUM=y
CONFIG_PM_PARTITION_SIZE_TFM_SRAM=0x18000
CONFIG_MBEDTLS_HEAP_SIZE=16384 

# Logging
CONFIG_LOG=y
CONFIG_LOG_PROCESS_THREAD_STACK_SIZE=4096
CONFIG_LOG_BUFFER_SIZE=4096
# DK library
CONFIG_DK_LIBRARY=y

# System settings
CONFIG_NEWLIB_LIBC=y
CONFIG_NEWLIB_LIBC_NANO=n

# Networking
CONFIG_NETWORKING=y
CONFIG_NET_NATIVE=y
CONFIG_NET_SOCKETS=y
CONFIG_NET_L2_ETHERNET=y
CONFIG_NET_IPV6=n
CONFIG_NET_IPV4=y
CONFIG_NET_DHCPV4=y

# Memory
CONFIG_SYSTEM_WORKQUEUE_STACK_SIZE=8192
CONFIG_MAIN_STACK_SIZE=4096
CONFIG_HEAP_MEM_POOL_SIZE=153600

# NFC 
CONFIG_NFC_T4T_NRFXLIB=y
CONFIG_NFC_NDEF=y
CONFIG_NDEF_FILE_SIZE=1024
CONFIG_ASSERT=y
CONFIG_NFC_T4T_HL_PROCEDURE=y
CONFIG_NFC_T4T_HL_PROCEDURE_CC_BUFFER_SIZE=248

# UDP
CONFIG_NET_SOCKETS_OFFLOAD=n
CONFIG_NET_SOCKETS_POSIX_NAMES=y
CONFIG_POSIX_MAX_FDS=16
CONFIG_DNS_RESOLVER=y
CONFIG_NET_UDP=y
```

## src/main.c
```c
/*
 * Copyright (c) 2024 Nordic Semiconductor ASA
 *
 * SPDX-License-Identifier: LicenseRef-Nordic-5-Clause
 */
#include <zephyr/kernel.h>
#include <zephyr/logging/log.h>
#include <zephyr/net/net_mgmt.h>
#include <zephyr/net/net_event.h>
#include <zephyr/net/wifi_mgmt.h>
#include <net/wifi_mgmt_ext.h>
#include <dk_buttons_and_leds.h>
#include "nfc_wifi_prov.h"
#include "udp_client.h"

#define L4_EVENT_MASK (NET_EVENT_L4_CONNECTED | NET_EVENT_L4_DISCONNECTED)
LOG_MODULE_REGISTER(wifi_prov_over_nfc, LOG_LEVEL_INF);

static struct net_mgmt_event_callback mgmt_cb;
static K_SEM_DEFINE(run_wifi_app, 0, 1);

static void net_mgmt_event_handler(struct net_mgmt_event_callback *cb, uint32_t mgmt_event,
				   struct net_if *iface)
{
	switch (mgmt_event) {
	case NET_EVENT_L4_CONNECTED:
		LOG_INF("Network connected");
		dk_set_led_on(DK_LED1);
		k_sem_give(&run_wifi_app);
		break;
	case NET_EVENT_L4_DISCONNECTED:
		dk_set_led_off(DK_LED1);
		LOG_INF("Network disconnected");
		break;
	default:
		LOG_DBG("Unknown event: 0x%08X", mgmt_event);
		return;
	}
}

int main(void)
{

	if (dk_leds_init() != 0) {
		LOG_ERR("Failed to initialize the LED library");
	}
	if (dk_buttons_init(NULL) != 0) {
		LOG_ERR("Failed to initialize the buttons library");
	}
	/* Sleep to allow initialization of Wi-Fi driver */
	k_sleep(K_SECONDS(1));

	net_mgmt_init_event_callback(&mgmt_cb, net_mgmt_event_handler, L4_EVENT_MASK);
	net_mgmt_add_event_callback(&mgmt_cb);

	if (nfc_provision() < 0) {
		LOG_ERR("Failed to start NFC provisioning");
	}
	/* Apply already stored credentials, if any exists */
	struct net_if *iface = net_if_get_first_by_type(&NET_L2_GET_NAME(ETHERNET));
	net_mgmt(NET_REQUEST_WIFI_CONNECT_STORED, iface, NULL, 0);

	k_sem_take(&run_wifi_app, K_FOREVER);
	/*  Add your Wi-Fi application after this point */
	start_udp_client();
	return 0;
}
```

## src/nfc_wifi_prov.c
```c
/*
 * Copyright (c) 2024 Nordic Semiconductor ASA
 *
 * SPDX-License-Identifier: LicenseRef-Nordic-5-Clause
 */
#include <stdbool.h>
#include <zephyr/kernel.h>
#include <zephyr/logging/log.h>
#include <zephyr/net/net_if.h>
#include <zephyr/net/wifi.h>
#include <zephyr/net/wifi_mgmt.h>
#include <net/wifi_credentials.h>
#include <nfc_t4t_lib.h>
#include <dk_buttons_and_leds.h>
#include <net/wifi_mgmt_ext.h>


#define L4_EVENT_MASK (NET_EVENT_L4_CONNECTED | NET_EVENT_L4_DISCONNECTED)
LOG_MODULE_REGISTER(nfc_prov, LOG_LEVEL_INF);

static struct wifi_credentials_personal creds;
static uint8_t ndef_msg_buf[CONFIG_NDEF_FILE_SIZE]; /**< Buffer for NDEF file. */
static struct net_if *iface;
struct k_timer press_hold_release_timer;

static void erase_all_credentials(void *cb_arg, const char *ssid, size_t ssid_len)
{
	wifi_credentials_delete_by_ssid(ssid, ssid_len);
}

static void button_handler_remove_cred(uint32_t button_state, uint32_t has_changed)
{
	if (DK_BTN1_MSK & has_changed) {
		if (DK_BTN1_MSK & button_state) {
			/* Button pressed. Start timer */
			k_timer_start(&press_hold_release_timer,
				      K_SECONDS(CONFIG_PRESS_HOLD_RELEASE_TIME), K_NO_WAIT);
		} else {
			/* Button released. Check if elapsed time is >=
			 * CONFIG_PRESS_HOLD_RELEASE_TIME */
			if (k_timer_status_get(&press_hold_release_timer) > 0) {
				LOG_INF("Long press detected! erasing all credential");
				wifi_credentials_for_each_ssid(erase_all_credentials, NULL);
				net_mgmt(NET_REQUEST_WIFI_DISCONNECT, iface, NULL, 0);
				/* Time elapsed is < CONFIG_PRESS_HOLD_RELEASE_TIME. Stop timer */
			} else {
				k_timer_stop(&press_hold_release_timer);
			}
		}
	}
}

static struct button_handler button_cb_nfc = {
	.cb = button_handler_remove_cred,
};
static struct net_mgmt_event_callback wifi_prov_mgmt_cb;
/* An experimental function to parse NFC NDEF Wi-Fi record
Assumptions:
Authentication: WPA-2 Personal
*/
int parse_ndef_wifi_record(size_t payloadLength, struct wifi_credentials_personal *wifiConfig)
{
	int i = 0;
	uint8_t *ptr_data = (uint8_t *)ndef_msg_buf;

	/* Getting the Authentication and encryption type
	  TODO: Support other modes and extract from data*/
	wifiConfig->header.type = WIFI_SECURITY_TYPE_PSK;
	/* Getting the SSID */

	while (ndef_msg_buf[i] != 'E') {
		i++;
	}
	ptr_data += i + 1;
	wifiConfig->header.ssid_len = (((uint16_t) * (ptr_data)) << 8) | *(ptr_data + 1);
	if (wifiConfig->header.ssid_len > WIFI_SSID_MAX_LEN) {
		LOG_ERR("SSID too long");
		return -1;
	}
	memcpy(wifiConfig->header.ssid, ptr_data + 2, wifiConfig->header.ssid_len);
	wifiConfig->header.ssid[wifiConfig->header.ssid_len] = '\0';
	LOG_DBG("SSID: %s SSID len %d\n", wifiConfig->header.ssid, wifiConfig->header.ssid_len);

	/* Getting the password */
	ptr_data += wifiConfig->header.ssid_len + 16;
	wifiConfig->password_len = (((uint16_t) * (ptr_data)) << 8) | *(ptr_data + 1);
	if (wifiConfig->password_len > WIFI_PSK_MAX_LEN) {
		LOG_ERR("Password too long");
		return -1;
	}
	memcpy(wifiConfig->password, ptr_data + 2, wifiConfig->password_len);
	wifiConfig->password[wifiConfig->password_len] = '\0';
	LOG_DBG("Password: %s Password len %d\n", wifiConfig->password, wifiConfig->password_len);
	return 0;
}

static void wifi_mgmt_event_handler(struct net_mgmt_event_callback *cb, uint32_t mgmt_event,
				    struct net_if *iface)
{
	switch (mgmt_event) {
	case NET_EVENT_L4_DISCONNECTED:
		LOG_INF("Turning on NFC");
		nfc_t4t_emulation_start();
		break;
	case NET_EVENT_L4_CONNECTED:
		/* Delete temporary credentials from the application. Only TF-M should have access
		 to credentials */
		memset(&creds.password, 0, creds.password_len);
		memset(&creds.password_len, 0, sizeof(unsigned int));
		memset(&creds.header.ssid, 0, creds.header.ssid_len);
		memset(&creds.header.ssid_len, 0, sizeof(unsigned int));
		memset(ndef_msg_buf, 0, CONFIG_NDEF_FILE_SIZE);
		/* Stop NFC to prevent power waste */
		LOG_INF("Turning off NFC");
		nfc_t4t_emulation_stop();
		break;
	default:
		break;
	}
}

/**
 * @brief Callback function for handling NFC events.
 */
static void nfc_callback(void *context, nfc_t4t_event_t event, const uint8_t *data,
			 size_t data_length, uint32_t flags)
{
	ARG_UNUSED(context);
	ARG_UNUSED(data);
	ARG_UNUSED(flags);
	switch (event) {
	case NFC_T4T_EVENT_FIELD_ON:
		/* do nothing */
		break;

	case NFC_T4T_EVENT_FIELD_OFF:
		/* do nothing */
		break;

	case NFC_T4T_EVENT_NDEF_READ:
		/* do nothing */
		break;

	case NFC_T4T_EVENT_NDEF_UPDATED:
		if (data_length > 0) {
			if (parse_ndef_wifi_record(data_length, &creds) < 0) {
				LOG_ERR("Error parsing NFC data or unsupported authentication "
					"type");
				return;
			}
			LOG_HEXDUMP_DBG(data, data_length, "NFC RECORD: ");
			if (wifi_credentials_set_personal_struct(&creds) < 0) {
				LOG_ERR("Error adding credentials");
				return;
			}
			net_mgmt(NET_REQUEST_WIFI_CONNECT_STORED, iface, NULL, 0);
		}
		break;

	default:
		break;
	}
}

/**
 * @brief   Function for provisioning Wi-Fi over NFC
 */
int nfc_provision(void)
{
	LOG_INF("Starting NFC Provisioning");
	iface = net_if_get_default();

	/* Set up NFC */
	int err = nfc_t4t_setup(nfc_callback, NULL);

	if (err < 0) {
		printk("Cannot setup t4t library!\n");
		return -1;
	}
	/* Run Read-Write mode for Type 4 Tag platform */
	if (nfc_t4t_ndef_rwpayload_set(ndef_msg_buf, sizeof(ndef_msg_buf)) < 0) {
		printk("Cannot set payload!\n");
		return -1;
	}
	/* Start sensing NFC field */
	if (nfc_t4t_emulation_start() < 0) {
		printk("Cannot start emulation!\n");
		return -1;
	}
	/* Remove credentials on long button press */
	dk_button_handler_add(&button_cb_nfc);
	net_mgmt_init_event_callback(&wifi_prov_mgmt_cb, wifi_mgmt_event_handler, L4_EVENT_MASK);

	net_mgmt_add_event_callback(&wifi_prov_mgmt_cb);
	return 0;
}
```

## src/nfc_wifi_prov.h
```c
/*
 * Copyright (c) 2024 Nordic Semiconductor ASA
 *
 * SPDX-License-Identifier: LicenseRef-Nordic-5-Clause
 */
#ifndef _NFC_WIFI_PROVISION_H_
#define _NFC_WIFI_PROVISION_H_
/**
 * @brief   Function for provisiong Wi-Fi over NFC
 */
int nfc_provision(void);
#endif /* _NFC_WIFI_PROVISION_H_ */
```

## src/udp_client.c
```c
/*
 * Copyright (c) 2024 Nordic Semiconductor ASA
 *
 * SPDX-License-Identifier: LicenseRef-Nordic-5-Clause
 */
#include <errno.h>
#include <stddef.h>
#include <string.h>
#include <stdio.h>
#include <zephyr/kernel.h>
#include <zephyr/types.h>
#include <zephyr/logging/log.h>
#include <zephyr/net/wifi.h>
#include <zephyr/net/wifi_mgmt.h>
#include <zephyr/net/net_mgmt.h>
#include <zephyr/net/socket.h>
#include <dk_buttons_and_leds.h>
#include "udp_client.h"

#define SSTRLEN(s) (sizeof(s) - 1)
LOG_MODULE_REGISTER(udp_connection, LOG_LEVEL_INF);

static int sock;
static struct sockaddr_storage server;
static uint8_t recv_buf[CONFIG_REPLY_BUFFER_SIZE];

static int server_resolve(void)
{
	int err;
	struct addrinfo *result;
	struct addrinfo hints = {
		.ai_family = AF_INET,
		.ai_socktype = SOCK_DGRAM,
	};

	err = getaddrinfo(CONFIG_UDP_ECHO_SERVER_HOSTNAME, CONFIG_UDP_ECHO_SERVER_PORT, &hints,
			  &result);
	if (err != 0) {
		LOG_INF("getaddrinfo() failed, err: %d", err);
		return -EIO;
	}

	if (result == NULL) {
		LOG_INF("Error, address not found");
		return -ENOENT;
	}

	struct sockaddr_in *server4 = ((struct sockaddr_in *)&server);

	server4->sin_addr.s_addr = ((struct sockaddr_in *)result->ai_addr)->sin_addr.s_addr;
	server4->sin_family = AF_INET;
	server4->sin_port = ((struct sockaddr_in *)result->ai_addr)->sin_port;

	char ipv4_addr[NET_IPV4_ADDR_LEN];
	inet_ntop(AF_INET, &server4->sin_addr.s_addr, ipv4_addr, sizeof(ipv4_addr));
	LOG_INF("IPv4 address of server found %s", ipv4_addr);

	freeaddrinfo(result);

	return 0;
}

static int server_connect(void)
{
	int err;
	sock = socket(AF_INET, SOCK_DGRAM, IPPROTO_UDP);
	if (sock < 0) {
		LOG_INF("Failed to create socket, err: %d, %s", errno, strerror(errno));
		return -errno;
	}

	err = connect(sock, (struct sockaddr *)&server, sizeof(struct sockaddr_in));
	if (err < 0) {
		LOG_INF("Connecting to server failed, err: %d, %s", errno, strerror(errno));
		return -errno;
	}
	LOG_INF("Successfully connected to server");

	return 0;
}
static void button_handler(uint32_t button_state, uint32_t has_changed)
{
	if (has_changed & DK_BTN1_MSK && button_state & DK_BTN1_MSK) {
		int err = send(sock, CONFIG_MESSAGE_TO_SEND, SSTRLEN(CONFIG_MESSAGE_TO_SEND), 0);
		if (err < 0) {
			LOG_INF("Failed to send message, %d", errno);
			return;
		}
		LOG_INF("Successfully sent message: %s", CONFIG_MESSAGE_TO_SEND);
	}
}
static struct button_handler button_cb_client = {
	.cb = button_handler,
};
int start_udp_client(void)
{
	int received;

	dk_button_handler_add(&button_cb_client);

	if (server_resolve() != 0) {
		LOG_INF("Failed to resolve server name");
		return 0;
	}

	if (server_connect() != 0) {
		LOG_INF("Failed to initialize client");
		return 0;
	}

	LOG_INF("Press Button1 on your DK to send your message");

	while (1) {
		received = recv(sock, recv_buf, sizeof(recv_buf) - 1, 0);

		if (received < 0) {
			LOG_ERR("Socket error: %d, exit", errno);
			break;
		}

		if (received == 0) {
			LOG_ERR("Empty datagram");
			break;
		}

		recv_buf[received] = 0;
		LOG_INF("Data received from the server: (%s)", recv_buf);
	}
	close(sock);
	return 0;
}
```

## src/udp_client.h
```c
/*
 * Copyright (c) 2024 Nordic Semiconductor ASA
 *
 * SPDX-License-Identifier: LicenseRef-Nordic-5-Clause
 */
#ifndef _UDP_CLIENT_H_
#define _UDP_CLIENT_H_
/**
 * @brief   Function for sending a message to a UDP echo server
 */
int start_udp_client(void);
#endif /* _UDP_CLIENT_H_ */
```
